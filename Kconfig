## Kconfig
```kconfig
# SPDX-License-Identifier: GPL-2.0

config VIDEO_SUN4I_CSI1
	tristate "Allwinner A10/A20 CMOS Sensor Interface 1 Support"
	depends on ARCH_SUNXI || COMPILE_TEST
	help
	  This is a V4L2 driver for the Allwinner A10/A20 CMOS sensor
	  interface. This is the secondary interface which, amongst
	  others, allows for 24bit RGB input.

	  To compile this driver as a module, choose M here: the module
	  will be called sun4i_csi1.
```
